## firmware/targets/esp_mosaico/main/Kconfig.projbuild
```kconfig
menu "ESP-Mosaico Usage Panel"

menu "Display"

config MOSAICO_USAGE_PANEL_DISPLAY_BRIGHTNESS_PERCENT
    int "Display brightness (percent)"
    range 1 100
    default 75
    help
        Panel brightness applied once at startup through the BSP brightness
        API. The screensaver does not dim the panel beyond this value.

config MOSAICO_USAGE_PANEL_AUTO_ROTATION
    bool "Auto-rotate the panel with gravity"
    default y
    help
        Follow the BMI270 accelerometer and rotate display and touch mapping
        together. When disabled, the panel keeps the fixed orientation chosen
        below and ignores gravity entirely.

choice MOSAICO_USAGE_PANEL_FIXED_ROTATION
    prompt "Fixed screen orientation"
    depends on !MOSAICO_USAGE_PANEL_AUTO_ROTATION
    default MOSAICO_USAGE_PANEL_FIXED_ROTATION_0
    help
        Orientation used whenever auto rotation is disabled. The touch
        transform follows this choice so coordinates stay aligned.

config MOSAICO_USAGE_PANEL_FIXED_ROTATION_0
    bool "0 degrees"

config MOSAICO_USAGE_PANEL_FIXED_ROTATION_90
    bool "90 degrees clockwise"

config MOSAICO_USAGE_PANEL_FIXED_ROTATION_180
    bool "180 degrees"

config MOSAICO_USAGE_PANEL_FIXED_ROTATION_270
    bool "270 degrees clockwise"

endchoice

endmenu

menu "Screensaver & Wake"

config MOSAICO_USAGE_PANEL_SCREENSAVER_TIMEOUT_SECONDS
    int "Screensaver idle timeout (seconds)"
    range 10 86400
    default 300
    help
        Seconds without touch, wake or connection activity before the clock
        screensaver starts. Pairing and OTA always keep the panel awake.

config MOSAICO_USAGE_PANEL_SHAKE_WAKE
    bool "Wake from the screensaver by shaking"
    default y
    help
        Let repeated acceleration excursions wake the panel while the clock
        screensaver is active.

config MOSAICO_USAGE_PANEL_SHAKE_WAKE_THRESHOLD_CG
    int "Shake wake excursion threshold (centi-g)"
    range 5 100
    default 25
    depends on MOSAICO_USAGE_PANEL_SHAKE_WAKE
    help
        Acceleration magnitude must differ from 1 g by more than this many
        hundredths of a g (default 0.25 g) for a shake sample to count toward
        waking the screensaver.

config MOSAICO_USAGE_PANEL_TILT_WAKE
    bool "Wake from the screensaver by tilting"
    default y
    help
        Let a sustained reorientation of the gravity direction wake the panel
        while the clock screensaver is active.

config MOSAICO_USAGE_PANEL_TILT_WAKE_DEGREES
    int "Tilt wake threshold (degrees)"
    range 5 60
    default 25
    depends on MOSAICO_USAGE_PANEL_TILT_WAKE
    help
        A sustained rotation of the gravity direction by more than this angle
        wakes the screensaver, so picking the panel up exits the clock while
        ordinary desk vibration does not.

endmenu

menu "Bluetooth"

config MOSAICO_USAGE_PANEL_BLE_ADVERTISING_PREFIX
    string "BLE advertising name prefix"
    default "QF-Mosaico-"
    help
        Prefix of the BLE advertising name. The full name is this prefix plus
        the last two Bluetooth MAC bytes as four uppercase hex digits, for
        example QF-Mosaico-A37F, so multiple panels stay distinguishable
        without manual coordination. Keep the prefix within 15 characters so
        prefix plus suffix fits the advertising name buffer.

        The prefix must start with QF- and contain at most 15 printable ASCII
        characters without spaces. Discovery requires both this public
        namespace and NUS; no official target registry entry is needed.
        The four-digit suffix may collide and is not a unique identity.
        Owned devices reconnect by Bluetooth address; status supplies their
        display names, capabilities and optional OTA project/target metadata.

endmenu

endmenu
```

## firmware/targets/esp_mosaico/sdkconfig.defaults
```kconfig
CONFIG_IDF_TARGET="esp32s31"
CONFIG_ESPTOOLPY_FLASHSIZE_16MB=y
CONFIG_PARTITION_TABLE_CUSTOM=y
CONFIG_PARTITION_TABLE_CUSTOM_FILENAME="partitions.csv"
CONFIG_BOOTLOADER_APP_ROLLBACK_ENABLE=y
CONFIG_COMPILER_OPTIMIZATION_PERF=y
CONFIG_FREERTOS_HZ=1000
CONFIG_LOG_DEFAULT_LEVEL_INFO=y

CONFIG_SPIRAM=y
CONFIG_SPIRAM_MODE_OCT=y
CONFIG_SPIRAM_SPEED_250M=y
CONFIG_SPIRAM_XIP_FROM_PSRAM=y

# The driver default of 2000 ms delays the first battery reading; the driver still
# confirms the sealed state after this wait and fails initialization otherwise.
CONFIG_BQ27220_SEAL_SETTLE_MS=200

CONFIG_BSP_DISPLAY_ENABLE=y
CONFIG_BSP_CO5300_ENABLE_TE=y

CONFIG_LV_COLOR_DEPTH_16=y
CONFIG_LV_OS_FREERTOS=y
CONFIG_LV_DEF_REFR_PERIOD=15
# Clock glyph buffers and UI objects share the ESP-IDF heap instead of a fixed LVGL pool.
CONFIG_LV_USE_CLIB_MALLOC=y
CONFIG_LV_USE_CLIB_STRING=y
CONFIG_LV_USE_CLIB_SPRINTF=y
CONFIG_LV_OBJ_STYLE_CACHE=y
CONFIG_LV_DRAW_SW_DRAW_UNIT_CNT=2
CONFIG_LV_USE_FLOAT=y
CONFIG_LV_USE_GESTURE_RECOGNITION=y
CONFIG_LV_FONT_MONTSERRAT_12=y
CONFIG_LV_FONT_MONTSERRAT_14=y
CONFIG_LV_FONT_MONTSERRAT_16=y
CONFIG_LV_FONT_MONTSERRAT_18=y
CONFIG_LV_FONT_MONTSERRAT_20=y
CONFIG_LV_FONT_MONTSERRAT_22=y
CONFIG_LV_FONT_MONTSERRAT_24=y
CONFIG_LV_FONT_MONTSERRAT_26=y
CONFIG_LV_FONT_MONTSERRAT_30=y
CONFIG_LV_FONT_MONTSERRAT_34=y
CONFIG_LV_FONT_MONTSERRAT_48=y
CONFIG_LV_USE_FONT_COMPRESSED=y

CONFIG_LV_USE_BAR=y
CONFIG_LV_USE_BUTTON=y
CONFIG_LV_USE_LABEL=y
CONFIG_LV_USE_FLEX=y
# CONFIG_LV_USE_GRID is not set
# CONFIG_LV_BUILD_EXAMPLES is not set
# CONFIG_LV_BUILD_DEMOS is not set

CONFIG_BT_ENABLED=y
CONFIG_BT_NIMBLE_ENABLED=y
CONFIG_BT_NIMBLE_ROLE_CENTRAL=n
CONFIG_BT_NIMBLE_ROLE_OBSERVER=n
CONFIG_BT_NIMBLE_ROLE_BROADCASTER=y
CONFIG_BT_NIMBLE_ROLE_PERIPHERAL=y
CONFIG_BT_NIMBLE_MAX_CONNECTIONS=1
CONFIG_BT_NIMBLE_MAX_BONDS=3
CONFIG_BT_NIMBLE_NVS_PERSIST=y
CONFIG_BT_NIMBLE_SM_SC_ONLY=1
CONFIG_BT_NIMBLE_SM_LVL=3
CONFIG_BT_NIMBLE_LOG_LEVEL_WARNING=y
CONFIG_BT_NIMBLE_ATT_PREFERRED_MTU=517

CONFIG_ESP_DESKTOP_BUDDY_RX_INBOX_DEPTH=32
CONFIG_ESP_DESKTOP_BUDDY_TX_QUEUE_DEPTH=4
CONFIG_ESP_DESKTOP_BUDDY_FOLDER_PUSH_MAX_RAW_CHUNK=4096
CONFIG_ESP_DESKTOP_BUDDY_FOLDER_PUSH_MAX_DECODED_CHUNK=2880
CONFIG_ESP_DESKTOP_BUDDY_FOLDER_PUSH_MAX_TRANSFER_BYTES=7340544
CONFIG_ESP_DESKTOP_BUDDY_FOLDER_PUSH_FLAT_PATHS_ONLY=y

# CameraBoard D2 occupies the USB Serial/JTAG pad. Type-C CDC uses USB OTG.
CONFIG_ESP_CONSOLE_SECONDARY_NONE=y
CONFIG_TINYUSB_CDC_ENABLED=y
CONFIG_USB_HS_CONSOLE_USB_CDC_AUTO_DOWNLOAD=y
CONFIG_USB_HS_CONSOLE_USB_CDC_AUTO_INIT=y
CONFIG_TINYUSB_DESC_PRODUCT_STRING="QuotaFrame Mosaico"
CONFIG_ESP_VIDEO_ENABLE_DVP_VIDEO_DEVICE=y
CONFIG_CAMERA_OV3640=y
CONFIG_CAMERA_OV3640_DVP_YUV422_UYVY_640X480_30FPS=y
CONFIG_CAMERA_OV3640_DVP_DEFAULT_FMT_YUV422_UYVY_640X480_30FPS=y
# CameraBoards ship with either sensor, as in esp-mosaico-bsp mosaico_module_camera;
# esp_video probes both and keeps the one that answers.
CONFIG_CAMERA_SC101IOT=y
CONFIG_CAMERA_SC101IOT_AUTO_DETECT_DVP_INTERFACE_SENSOR=y
# SC101IOT VGA crops the sensor center; 720p retains the full field of view.
CONFIG_CAMERA_SC101IOT_DVP_YUV422_1280X720_15FPS=y
CONFIG_CAMERA_SC101IOT_DVP_DEFAULT_FMT_YUV422_1280X720_15FPS=y
# CONFIG_CAMERA_SC101IOT_DVP_YUV422_640X480_15FPS is not set
# CONFIG_CAMERA_SC101IOT_DVP_DEFAULT_FMT_YUV422_640X480_15FPS is not set
CONFIG_MOSAICO_GESTURE_INPUT=y
CONFIG_MOSAICO_CAMERA_ROTATION=90
CONFIG_MOSAICO_CAMERA_MIRROR=y

# The vision pipeline supplies RGB888; other ESP-DL converters are unused.
# CONFIG_PIX_CVT_RGB565_TO_RGB565_SUPPORT is not set
# CONFIG_PIX_CVT_RGB565_TO_RGB888_SUPPORT is not set
# CONFIG_PIX_CVT_RGB565_TO_GRAY_SUPPORT is not set
# CONFIG_PIX_CVT_RGB565_TO_HSV_SUPPORT is not set
# CONFIG_PIX_CVT_RGB888_TO_RGB565_SUPPORT is not set
# CONFIG_PIX_CVT_RGB888_TO_GRAY_SUPPORT is not set
# CONFIG_PIX_CVT_RGB888_TO_HSV_SUPPORT is not set
# CONFIG_PIX_CVT_GRAY_TO_GRAY_SUPPORT is not set
# CONFIG_PIX_CVT_HSV_TO_HSV_MASK_SUPPORT is not set
# CONFIG_PIX_CVT_YUV_TO_RGB888_SUPPORT is not set
# CONFIG_PIX_CVT_YUV_TO_RGB565_SUPPORT is not set
# CONFIG_PIX_CVT_YUV_TO_GRAY_SUPPORT is not set
# CONFIG_PIX_CVT_YUV_TO_HSV_SUPPORT is not set
# CONFIG_PIX_CVT_YUV_TO_YUV_SUPPORT is not set
```

## firmware/targets/m5sticks3/main/Kconfig.projbuild
```kconfig
menu "M5 Usage Panel"

menu "Display"

config M5_USAGE_PANEL_DISPLAY_BRIGHTNESS_PERCENT
    int "Display brightness (percent)"
    range 1 100
    default 55
    help
        Panel brightness applied once at startup through M5GFX. The panel
        stays at this level; there is no screensaver dimming on this target.

choice M5_USAGE_PANEL_ROTATION
    prompt "Fixed screen orientation"
    default M5_USAGE_PANEL_ROTATION_0
    help
        The panel UI is laid out for upright portrait use, so only upright
        and inverted orientations are offered. Inverted mounting suits a
        desk stand that faces the panel away from the user.

config M5_USAGE_PANEL_ROTATION_0
    bool "0 degrees"

config M5_USAGE_PANEL_ROTATION_180
    bool "180 degrees (inverted)"

endchoice

endmenu

menu "Bluetooth"

config M5_USAGE_PANEL_BLE_ADVERTISING_PREFIX
    string "BLE advertising name prefix"
    default "QF-M5-"
    help
        Prefix of the BLE advertising name. The full name is this prefix plus
        the last two Bluetooth MAC bytes as four uppercase hex digits, for
        example QF-M5-A37F, so multiple panels stay distinguishable
        without manual coordination. Keep the prefix within 15 characters so
        prefix plus suffix fits the advertising name buffer.

        The prefix must start with QF- and contain at most 15 printable ASCII
        characters without spaces. Discovery requires both this public
        namespace and NUS; no official target registry entry is needed.
        The four-digit suffix may collide and is not a unique identity.
        Owned devices reconnect by Bluetooth address; status supplies their
        display names, capabilities and optional OTA project/target metadata.

endmenu

endmenu
```

## firmware/targets/m5sticks3/sdkconfig.defaults
```kconfig
CONFIG_IDF_TARGET="esp32s3"
CONFIG_ESPTOOLPY_FLASHSIZE_8MB=y
CONFIG_PARTITION_TABLE_CUSTOM=y
CONFIG_PARTITION_TABLE_CUSTOM_FILENAME="partitions.csv"
CONFIG_SPIRAM=y
CONFIG_SPIRAM_MODE_OCT=y
CONFIG_SPIRAM_SPEED_80M=y
CONFIG_BT_ENABLED=y
CONFIG_BT_NIMBLE_ENABLED=y
CONFIG_BT_NIMBLE_ROLE_CENTRAL=n
CONFIG_BT_NIMBLE_ROLE_OBSERVER=n
CONFIG_BT_NIMBLE_ROLE_BROADCASTER=y
CONFIG_BT_NIMBLE_ROLE_PERIPHERAL=y
CONFIG_BT_NIMBLE_MAX_CONNECTIONS=1
CONFIG_BT_NIMBLE_MAX_BONDS=3
CONFIG_BT_NIMBLE_NVS_PERSIST=y
CONFIG_BT_NIMBLE_SM_SC_ONLY=1
CONFIG_BT_NIMBLE_SM_LVL=3
CONFIG_BT_NIMBLE_LOG_LEVEL_WARNING=y
CONFIG_BT_NIMBLE_ATT_PREFERRED_MTU=517
CONFIG_ESP_DESKTOP_BUDDY_RX_INBOX_DEPTH=32
CONFIG_ESP_DESKTOP_BUDDY_FOLDER_PUSH_MAX_RAW_CHUNK=4096
CONFIG_ESP_DESKTOP_BUDDY_FOLDER_PUSH_MAX_DECODED_CHUNK=2880
CONFIG_ESP_DESKTOP_BUDDY_FOLDER_PUSH_MAX_TRANSFER_BYTES=3146240
CONFIG_ESP_DESKTOP_BUDDY_FOLDER_PUSH_FLAT_PATHS_ONLY=y
CONFIG_LOG_DEFAULT_LEVEL_INFO=y
CONFIG_BOOTLOADER_APP_ROLLBACK_ENABLE=y
```

## firmware/targets/waveshare_epaper_397/sdkconfig.defaults
```kconfig
CONFIG_IDF_TARGET="esp32s3"
CONFIG_ESPTOOLPY_FLASHMODE_QIO=y
CONFIG_ESPTOOLPY_FLASHSIZE_16MB=y
CONFIG_PARTITION_TABLE_CUSTOM=y
CONFIG_PARTITION_TABLE_CUSTOM_FILENAME="partitions.csv"
CONFIG_COMPILER_OPTIMIZATION_PERF=y

CONFIG_SPIRAM=y
CONFIG_SPIRAM_MODE_OCT=y
CONFIG_SPIRAM_FETCH_INSTRUCTIONS=y
CONFIG_SPIRAM_RODATA=y
CONFIG_SPIRAM_SPEED_80M=y
CONFIG_SPIRAM_XIP_FROM_PSRAM=y
CONFIG_ESP32S3_INSTRUCTION_CACHE_32KB=y
CONFIG_ESP32S3_DATA_CACHE_64KB=y
CONFIG_ESP32S3_DATA_CACHE_LINE_64B=y
CONFIG_ESP_DEFAULT_CPU_FREQ_MHZ_240=y

CONFIG_FREERTOS_HZ=1000
CONFIG_SPIRAM_MALLOC_ALWAYSINTERNAL=16384


CONFIG_BT_ENABLED=y
CONFIG_BT_NIMBLE_ENABLED=y
CONFIG_BT_NIMBLE_ROLE_CENTRAL=n
CONFIG_BT_NIMBLE_ROLE_OBSERVER=n
CONFIG_BT_NIMBLE_ROLE_BROADCASTER=y
CONFIG_BT_NIMBLE_ROLE_PERIPHERAL=y
CONFIG_BT_NIMBLE_MAX_CONNECTIONS=1
CONFIG_BT_NIMBLE_MAX_BONDS=3
CONFIG_BT_NIMBLE_NVS_PERSIST=y
CONFIG_BT_NIMBLE_SM_SC_ONLY=1
CONFIG_BT_NIMBLE_SM_LVL=3
CONFIG_BT_NIMBLE_LOG_LEVEL_WARNING=y
CONFIG_BT_NIMBLE_ATT_PREFERRED_MTU=517
CONFIG_ESP_DESKTOP_BUDDY_RX_INBOX_DEPTH=32
CONFIG_ESP_DESKTOP_BUDDY_TX_QUEUE_DEPTH=4
CONFIG_ESP_DESKTOP_BUDDY_FOLDER_PUSH_MAX_RAW_CHUNK=4096
CONFIG_ESP_DESKTOP_BUDDY_FOLDER_PUSH_MAX_DECODED_CHUNK=2880
CONFIG_ESP_DESKTOP_BUDDY_FOLDER_PUSH_MAX_TRANSFER_BYTES=4194816
CONFIG_ESP_DESKTOP_BUDDY_FOLDER_PUSH_FLAT_PATHS_ONLY=y
CONFIG_LOG_DEFAULT_LEVEL_INFO=y
CONFIG_BOOTLOADER_APP_ROLLBACK_ENABLE=y
CONFIG_ESP_CONSOLE_USB_SERIAL_JTAG=y
CONFIG_ESP_MAIN_TASK_STACK_SIZE=12288
```

## firmware/test_apps/protocol/sdkconfig.defaults
```kconfig
CONFIG_IDF_TARGET="esp32s3"
CONFIG_BT_ENABLED=y
CONFIG_BT_NIMBLE_ENABLED=y
CONFIG_BT_NIMBLE_ROLE_CENTRAL=n
CONFIG_BT_NIMBLE_ROLE_OBSERVER=n
CONFIG_BT_NIMBLE_ROLE_BROADCASTER=y
CONFIG_BT_NIMBLE_ROLE_PERIPHERAL=y
CONFIG_BT_NIMBLE_MAX_CONNECTIONS=1
CONFIG_BT_NIMBLE_NVS_PERSIST=y
CONFIG_BT_NIMBLE_SM_SC_ONLY=1
CONFIG_BT_NIMBLE_SM_LVL=3
CONFIG_BT_NIMBLE_LOG_LEVEL_WARNING=y
```

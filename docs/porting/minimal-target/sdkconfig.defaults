## firmware/components/esp-mosaico-bsp/Kconfig
```kconfig
menu "ESP-Mosaico BSP"

    config BSP_DISPLAY_ENABLE
        bool "Enable BSP display support"
        default y

    config BSP_CO5300_ENABLE_TE
        bool "Enable CO5300 TE synchronization for partial refresh"
        depends on BSP_DISPLAY_ENABLE
        default y
        help
            Enable the CO5300 tearing-effect output on GPIO43. The BSP maps
            its default TE_SYNC request to partial rendering and waits for
            one fresh TE edge before the first transfer of each LVGL refresh.
            Remaining areas in the same refresh do not wait for another edge.
            TE waits time out after 25 ms if the panel signal is absent.

            Synchronizing the start does not guarantee tear-free updates that
            exceed the panel scan window. Large updates and rotated displays
            require hardware verification.

            Disable this option to omit the CO5300 TE-enable command and use
            the normal SPI display path without a TE interrupt.

    config BSP_LCD_QSPI_DRIVE_CAP
        int "QSPI LCD bus pin drive strength (0-3)"
        range 0 3
        default 0
        help
            GPIO drive capability for the CO5300 QSPI bus pins: SCL and DATA0-DATA3.
            Lower values reduce edge rate and RF emissions (useful for Wi-Fi/BLE
            coexistence). 0 = weakest (GPIO_DRIVE_CAP_0), 3 = strongest.
            Default is 0. Increase if display signal integrity fails at high clock.

    config BSP_MOTOR_ENABLE_PWM
        bool "Enable LEDC PWM motor control"
        default y

    config BSP_VCC_3V3_RAMP_MS
        int "VCC_3V3 soft-start ramp time (ms)"
        range 0 1000
        default 50
        help
            Sweep the duty cycle on the VCC_3V3 enable GPIO over this time so the
            high-side switch opens gradually. Set to 0 to drive the pin directly.

endmenu
```

## firmware/components/esp_desktop_buddy_folder_push/Kconfig
```kconfig
menu "ESP Desktop Buddy Folder Push"

config ESP_DESKTOP_BUDDY_FOLDER_PUSH_MAX_RAW_CHUNK
    int "Max base64 chunk length"
    range 64 4096
    default 1024
    help
        Maximum base64-encoded chunk bytes accepted by a single `chunk`
        command before the folder-push state machine rejects the request.

config ESP_DESKTOP_BUDDY_FOLDER_PUSH_MAX_DECODED_CHUNK
    int "Max decoded chunk length"
    range 64 4096
    default 512
    help
        Maximum decoded payload bytes accepted from a single `chunk`
        command before the state machine rejects the request prior to
        sink writeout.

        The implementation allocates a decode buffer of this size on the Buddy
        core task stack while handling a `chunk` command. Keep this value small
        enough to fit within the core task's stack budget.

config ESP_DESKTOP_BUDDY_FOLDER_PUSH_MAX_TRANSFER_BYTES
    int "Max transfer size bytes"
    range 0 4194816
    default 4194816
    help
        Maximum total decoded payload bytes accepted by a single `char_begin`
        transfer. Set this to zero to disable the limit. Transfers that exceed
        the configured cap are rejected before any sink callbacks run.
        OTA targets use the smaller app partition size plus 512 bytes for
        the manifest; the OTA backend also checks the image against its partition.

config ESP_DESKTOP_BUDDY_FOLDER_PUSH_FLAT_PATHS_ONLY
    bool "Restrict paths to flat relative filenames"
    default y
    help
        Reject paths containing `/` so the folder-push state machine accepts
        only flat relative filenames. Disable this if your sink intentionally
        supports nested directory staging.

endmenu
```

## firmware/components/usage_ota/Kconfig
```kconfig
menu "Usage Panel OTA"

config USAGE_OTA_MIN_BATTERY_PERCENT
    int "Minimum battery percent required for OTA on internal power"
    range 0 100
    default 40
    help
        Firmware updates are rejected unless the device reports external
        power or a battery percent greater than or equal to this value.
        A reading that cannot be taken also rejects the update (fail-closed).
        The name and the inclusive comparison are intentionally paired:
        MIN means at-or-above passes.

endmenu
```

## firmware/targets/esp32_s3_touch_amoled_216/main/Kconfig.projbuild
```kconfig
menu "Waveshare Usage Panel"

menu "Display"

config WS_USAGE_PANEL_DISPLAY_BRIGHTNESS_PERCENT
    int "Display brightness (percent)"
    range 1 100
    default 75
    help
        Panel brightness applied once at startup through the BSP brightness
        API. The screensaver does not dim the panel beyond this value.

config WS_USAGE_PANEL_AUTO_ROTATION
    bool "Auto-rotate the panel with gravity"
    default y
    help
        Follow the QMI8658 accelerometer and rotate display and touch mapping
        together. When disabled, the panel keeps the fixed orientation chosen
        below and ignores gravity entirely.

choice WS_USAGE_PANEL_FIXED_ROTATION
    prompt "Fixed screen orientation"
    depends on !WS_USAGE_PANEL_AUTO_ROTATION
    default WS_USAGE_PANEL_FIXED_ROTATION_0
    help
        Orientation used whenever auto rotation is disabled. The touch
        transform follows this choice so coordinates stay aligned.

config WS_USAGE_PANEL_FIXED_ROTATION_0
    bool "0 degrees"

config WS_USAGE_PANEL_FIXED_ROTATION_90
    bool "90 degrees clockwise"

config WS_USAGE_PANEL_FIXED_ROTATION_180
    bool "180 degrees"

config WS_USAGE_PANEL_FIXED_ROTATION_270
    bool "270 degrees clockwise"

endchoice

endmenu

menu "Screensaver & Wake"

config WS_USAGE_PANEL_SCREENSAVER_TIMEOUT_SECONDS
    int "Screensaver idle timeout (seconds)"
    range 10 86400
    default 300
    help
        Seconds without touch, wake or connection activity before the clock
        screensaver starts. Pairing and OTA always keep the panel awake.

config WS_USAGE_PANEL_SHAKE_WAKE
    bool "Wake from the screensaver by shaking"
    default y
    help
        Let repeated acceleration excursions wake the panel while the clock
        screensaver is active.

config WS_USAGE_PANEL_SHAKE_WAKE_THRESHOLD_CG
    int "Shake wake excursion threshold (centi-g)"
    range 5 100
    default 25
    depends on WS_USAGE_PANEL_SHAKE_WAKE
    help
        Acceleration magnitude must differ from 1 g by more than this many
        hundredths of a g (default 0.25 g) for a shake sample to count toward
        waking the screensaver.

config WS_USAGE_PANEL_TILT_WAKE
    bool "Wake from the screensaver by tilting"
    default y
    help
        Let a sustained reorientation of the gravity direction wake the panel
        while the clock screensaver is active.

config WS_USAGE_PANEL_TILT_WAKE_DEGREES
    int "Tilt wake threshold (degrees)"
    range 5 60
    default 25
    depends on WS_USAGE_PANEL_TILT_WAKE
    help
        A sustained rotation of the gravity direction by more than this angle
        wakes the screensaver, so picking the panel up exits the clock while
        ordinary desk vibration does not.

endmenu

menu "Bluetooth"

config WS_USAGE_PANEL_BLE_ADVERTISING_PREFIX
    string "BLE advertising name prefix"
    default "QF-WS-S3-A216-"
    help
        Prefix of the BLE advertising name. The full name is this prefix plus
        the last two Bluetooth MAC bytes as four uppercase hex digits, for
        example QF-WS-S3-A216-A37F, so multiple panels stay distinguishable
        without manual coordination. Keep the prefix within 15 characters so
        prefix plus suffix fits the advertising name buffer.

        The prefix must start with QF- and contain at most 15 printable ASCII
        characters without spaces. Discovery requires both this public
        namespace and NUS; no official target registry entry is needed.
        The four-digit suffix may collide and is not a unique identity.
        Owned devices reconnect by Bluetooth address; status supplies their
        display names, capabilities and optional OTA project/target metadata.

endmenu

menu "Diagnostics"

config WS_USAGE_PANEL_PERFORMANCE_PROBE
    bool "Record display DMA and periodic resource performance samples"
    default n
    select FREERTOS_GENERATE_RUN_TIME_STATS
    select FREERTOS_VTASKLIST_INCLUDE_COREID
    help
        Record LVGL refresh and final DMA completion timestamps, internal/DMA
        memory, task runtime counters, and stack headroom. Diagnostic builds
        use the ESP Timer runtime clock and emit serial samples only.

config WS_USAGE_PANEL_MEMORY_PROBE
    bool "Run one-shot LVGL memory and refresh probe"
    default n
    help
        Create and remove representative hidden UI objects, then time forced
        page refreshes. Enable only in a separate diagnostic build.

endmenu

endmenu
```

## firmware/targets/esp32_s3_touch_amoled_216/sdkconfig.defaults
```kconfig
CONFIG_IDF_TARGET="esp32s3"
CONFIG_ESPTOOLPY_FLASHMODE_QIO=y
CONFIG_ESPTOOLPY_FLASHSIZE_16MB=y
CONFIG_PARTITION_TABLE_CUSTOM=y
CONFIG_PARTITION_TABLE_CUSTOM_FILENAME="partitions.csv"
CONFIG_COMPILER_OPTIMIZATION_PERF=y

CONFIG_SPIRAM=y
CONFIG_SPIRAM_MODE_OCT=y
CONFIG_SPIRAM_FETCH_INSTRUCTIONS=y
CONFIG_SPIRAM_RODATA=y
CONFIG_SPIRAM_SPEED_80M=y
CONFIG_SPIRAM_XIP_FROM_PSRAM=y
CONFIG_ESP32S3_INSTRUCTION_CACHE_32KB=y
CONFIG_ESP32S3_DATA_CACHE_64KB=y
CONFIG_ESP32S3_DATA_CACHE_LINE_64B=y
CONFIG_ESP_DEFAULT_CPU_FREQ_MHZ_240=y

CONFIG_FREERTOS_HZ=1000
CONFIG_SPIRAM_MALLOC_ALWAYSINTERNAL=16384
CONFIG_LV_USE_BUILTIN_MALLOC=y
# CONFIG_LV_USE_CLIB_MALLOC is not set
CONFIG_LV_MEM_SIZE_KILOBYTES=128
CONFIG_LV_MEM_POOL_EXPAND_SIZE_KILOBYTES=0
CONFIG_LV_MEM_ADR=0x0
CONFIG_LV_USE_CLIB_STRING=y
CONFIG_LV_USE_CLIB_SPRINTF=y
CONFIG_LV_DEF_REFR_PERIOD=15
CONFIG_LV_OS_FREERTOS=y
CONFIG_LV_OBJ_STYLE_CACHE=y
CONFIG_LV_DRAW_SW_DRAW_UNIT_CNT=2
# CONFIG_LV_ATTRIBUTE_FAST_MEM_USE_IRAM is not set
CONFIG_LV_USE_FLOAT=y
CONFIG_LV_USE_GESTURE_RECOGNITION=y
CONFIG_LV_FONT_MONTSERRAT_12=y
CONFIG_LV_FONT_MONTSERRAT_14=y
CONFIG_LV_FONT_MONTSERRAT_16=y
CONFIG_LV_FONT_MONTSERRAT_18=y
CONFIG_LV_FONT_MONTSERRAT_20=y
CONFIG_LV_FONT_MONTSERRAT_22=y
CONFIG_LV_FONT_MONTSERRAT_24=y
CONFIG_LV_FONT_MONTSERRAT_26=y
CONFIG_LV_FONT_MONTSERRAT_30=y
CONFIG_LV_FONT_MONTSERRAT_34=y
CONFIG_LV_FONT_MONTSERRAT_48=y
CONFIG_LV_USE_FONT_COMPRESSED=y

CONFIG_LV_USE_BAR=y
CONFIG_LV_USE_BUTTON=y
CONFIG_LV_USE_LABEL=y
CONFIG_LV_USE_FLEX=y
# CONFIG_LV_USE_GRID is not set
# CONFIG_LV_BUILD_EXAMPLES is not set
# CONFIG_LV_BUILD_DEMOS is not set
# CONFIG_LV_USE_ANIMIMG is not set
# CONFIG_LV_USE_ARC is not set
# CONFIG_LV_USE_BUTTONMATRIX is not set
# CONFIG_LV_USE_CALENDAR is not set
# CONFIG_LV_USE_CANVAS is not set
# CONFIG_LV_USE_CHART is not set
# CONFIG_LV_USE_CHECKBOX is not set
# CONFIG_LV_USE_DROPDOWN is not set
# CONFIG_LV_USE_IMAGE is not set
# CONFIG_LV_USE_IMAGEBUTTON is not set
# CONFIG_LV_USE_KEYBOARD is not set
# CONFIG_LV_USE_LED is not set
# CONFIG_LV_USE_LINE is not set
# CONFIG_LV_USE_LIST is not set
# CONFIG_LV_USE_MENU is not set
# CONFIG_LV_USE_MSGBOX is not set
# CONFIG_LV_USE_ROLLER is not set
# CONFIG_LV_USE_SCALE is not set
# CONFIG_LV_USE_SLIDER is not set
# CONFIG_LV_USE_SPAN is not set
# CONFIG_LV_USE_SPINBOX is not set
# CONFIG_LV_USE_SPINNER is not set
# CONFIG_LV_USE_SWITCH is not set
# CONFIG_LV_USE_TABLE is not set
# CONFIG_LV_USE_TABVIEW is not set
# CONFIG_LV_USE_TEXTAREA is not set
# CONFIG_LV_USE_TILEVIEW is not set
# CONFIG_LV_USE_WIN is not set

CONFIG_BT_ENABLED=y
CONFIG_BT_NIMBLE_ENABLED=y
CONFIG_BT_NIMBLE_ROLE_CENTRAL=n
CONFIG_BT_NIMBLE_ROLE_OBSERVER=n
CONFIG_BT_NIMBLE_ROLE_BROADCASTER=y
CONFIG_BT_NIMBLE_ROLE_PERIPHERAL=y
CONFIG_BT_NIMBLE_MAX_CONNECTIONS=1
CONFIG_BT_NIMBLE_MAX_BONDS=3
CONFIG_BT_NIMBLE_NVS_PERSIST=y
CONFIG_BT_NIMBLE_SM_SC_ONLY=1
CONFIG_BT_NIMBLE_SM_LVL=3
CONFIG_BT_NIMBLE_LOG_LEVEL_WARNING=y
CONFIG_BT_NIMBLE_ATT_PREFERRED_MTU=517
CONFIG_ESP_DESKTOP_BUDDY_RX_INBOX_DEPTH=32
CONFIG_ESP_DESKTOP_BUDDY_TX_QUEUE_DEPTH=4
CONFIG_ESP_DESKTOP_BUDDY_FOLDER_PUSH_MAX_RAW_CHUNK=4096
CONFIG_ESP_DESKTOP_BUDDY_FOLDER_PUSH_MAX_DECODED_CHUNK=2880
CONFIG_ESP_DESKTOP_BUDDY_FOLDER_PUSH_MAX_TRANSFER_BYTES=4194816
CONFIG_ESP_DESKTOP_BUDDY_FOLDER_PUSH_FLAT_PATHS_ONLY=y
CONFIG_LOG_DEFAULT_LEVEL_INFO=y
CONFIG_BOOTLOADER_APP_ROLLBACK_ENABLE=y
```
